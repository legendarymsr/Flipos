## br2-external/package/flipos-wm/Config.in
```kconfig
config BR2_PACKAGE_FLIPOS_WM
	bool "flipos-wm (mobile Wayland compositor)"
	depends on BR2_PACKAGE_WLROOTS
	depends on BR2_PACKAGE_WAYLAND
	select BR2_PACKAGE_WAYLAND_PROTOCOLS
	select BR2_PACKAGE_LIBXKBCOMMON
	help
	  flipos's self-built minimal, mobile-styled wlroots compositor:
	  fullscreen one app at a time, launches a terminal on start.
```

## br2-external/package/gpgme/Config.in
```kconfig
config BR2_PACKAGE_GPGME
	bool "gpgme"
	select BR2_PACKAGE_LIBGPG_ERROR
	select BR2_PACKAGE_LIBASSUAN
	select BR2_PACKAGE_GNUPG2
	help
	  GnuPG Made Easy — the GPG signature library pacman uses to verify
	  package signatures.
	  https://gnupg.org/software/gpgme/
```
